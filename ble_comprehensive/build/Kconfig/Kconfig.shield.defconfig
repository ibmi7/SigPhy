## ble_comprehensive/build/Kconfig/Kconfig.shield.defconfig
```kconfig
osource "c:/Users/cours/Documents/Cours/EISE4/SigPhy/Test/peripheral_uart/boards/shields/*/Kconfig.defconfig"
osource "c:/Users/cours/Documents/Cours/EISE4/SigPhy/Test/peripheral_uart_v2_4ledsT3/boards/shields/*/Kconfig.defconfig"
osource "c:/Users/cours/Documents/Cours/EISE4/SigPhy/Test/peripheral_uart_test/boards/shields/*/Kconfig.defconfig"
osource "c:/Users/cours/Documents/Cours/EISE4/SigPhy/Test/peripheral_uart_spi/boards/shields/*/Kconfig.defconfig"
osource "c:/Users/cours/Documents/Cours/EISE4/SigPhy/Test/nrfx_ipc/ipc_service/boards/shields/*/Kconfig.defconfig"
osource "c:/Users/cours/Documents/Cours/EISE4/SigPhy/Test/ble_comprehensive/boards/shields/*/Kconfig.defconfig"
osource "C:/ncs/v2.3.0/nrf/boards/shields/*/Kconfig.defconfig"
```

## ble_ipc/netcore_ipc/build/Kconfig/Kconfig.shield
```kconfig
osource "c:/Users/cours/Documents/Cours/EISE4/SigPhy/Test/peripheral_uart/boards/shields/*/Kconfig.shield"
osource "c:/Users/cours/Documents/Cours/EISE4/SigPhy/Test/peripheral_uart_v2_4ledsT3/boards/shields/*/Kconfig.shield"
osource "c:/Users/cours/Documents/Cours/EISE4/SigPhy/Test/peripheral_uart_test/boards/shields/*/Kconfig.shield"
osource "c:/Users/cours/Documents/Cours/EISE4/SigPhy/Test/peripheral_uart_spi/boards/shields/*/Kconfig.shield"
osource "c:/Users/cours/Documents/Cours/EISE4/SigPhy/Test/nrfx_ipc/ipc_service/boards/shields/*/Kconfig.shield"
osource "C:/ncs/v2.2.99-dev3/nrf/boards/shields/*/Kconfig.shield"
```

## nrfx_ipc/appcore/build/Kconfig/Kconfig.shield.defconfig
```kconfig
osource "c:/Users/cours/Documents/Cours/EISE4/SigPhy/Test/peripheral_uart/boards/shields/*/Kconfig.defconfig"
osource "c:/Users/cours/Documents/Cours/EISE4/SigPhy/Test/peripheral_uart_v2_4ledsT3/boards/shields/*/Kconfig.defconfig"
osource "C:/ncs/v2.2.99-dev3/nrf/boards/shields/*/Kconfig.defconfig"
```

## peripheral_uart_v2_4ledsT3/build/Kconfig/Kconfig.shield
```kconfig
osource "c:/Users/cours/Documents/Cours/EISE4/SigPhy/Test/blinky_pwm/boards/shields/*/Kconfig.shield"
osource "c:/Users/cours/Documents/Cours/EISE4/SigPhy/Test/blinky_pwm2/boards/shields/*/Kconfig.shield"
osource "c:/Users/cours/Documents/Cours/EISE4/SigPhy/Test/display/boards/shields/*/Kconfig.shield"
osource "c:/Users/cours/Documents/Cours/EISE4/SigPhy/Test/peripheral_uart/boards/shields/*/Kconfig.shield"
osource "c:/Users/cours/Documents/Cours/EISE4/SigPhy/Test/spi_bitbang/boards/shields/*/Kconfig.shield"
osource "c:/Users/cours/Documents/Cours/EISE4/SigPhy/Test/ipc_service/boards/shields/*/Kconfig.shield"
osource "c:/Users/cours/Documents/Cours/EISE4/SigPhy/Test/peripheral_uart_v2_4ledsT3/boards/shields/*/Kconfig.shield"
osource "C:/ncs/v2.2.99-dev3/nrf/boards/shields/*/Kconfig.shield"
```
